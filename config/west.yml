## config/west.yml
```yaml
manifest:
  remotes:
    - name: zmkfirmware
      url-base: https://github.com/zmkfirmware
    - name: loogdream
      url-base: https://github.com/logdream
  projects:
    - name: zmk
      remote: loogdream
      revision: bb10
      import: app/west.yml
  self:
    path: config
```
